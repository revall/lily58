## config/west.yml
```yaml
manifest:
  remotes:
    - name: zmkfirmware
      url-base: https://github.com/zmkfirmware
    - name: petejohanson
      url-base: https://github.com/petejohanson
    - name: badjeff
      url-base: https://github.com/badjeff
    - name: AYM1607
      url-base: https://github.com/AYM1607
  projects:
    - name: zmk
     remote: zmkfirmware
     revision: main
     import: app/west.yml
    # - name: zmk
    #   remote: badjeff
    #   revision: feat/pointers-with-input-processors
    #   import: app/west.yml
    ## Modules ##
    - name: zmk-driver-azoteq-iqs5xx
      remote: AYM1607
      revision: main
  self:
    path: config
    
```
